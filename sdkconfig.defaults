## sdkconfig.defaults
```kconfig
CONFIG_IDF_TARGET="esp32h2"

# Console on UART0 (via the CP2102N). 115200 is default.
CONFIG_ESP_CONSOLE_UART_DEFAULT=y
CONFIG_ESP_CONSOLE_UART_BAUDRATE=115200

# Cleaner CSV stream — keep info logs but drop debug noise.
CONFIG_LOG_DEFAULT_LEVEL_INFO=y

# Zigbee: end-device on native 802.15.4 radio (esp32h2).
CONFIG_ZB_ENABLED=y
CONFIG_ZB_ZED=y
CONFIG_ZB_RADIO_NATIVE=y

# Custom partition table adds zb_storage (16K) and zb_fct (1K),
# required by esp-zboss-lib for persistent Zigbee NWK/security state.
CONFIG_PARTITION_TABLE_CUSTOM=y
CONFIG_PARTITION_TABLE_CUSTOM_FILENAME="partitions.csv"

# Give the Zigbee main loop a bit more stack headroom than the default.
CONFIG_ESP_MAIN_TASK_STACK_SIZE=4096

# OTA: use both ota_0/ota_1 slots in the partition table, with bootloader-
# managed rollback so a bricked upgrade self-recovers on next power cycle.
CONFIG_BOOTLOADER_APP_ROLLBACK_ENABLE=y
CONFIG_APP_ROLLBACK_ENABLE=y

# The ESP32-H2-DevKitM-1-N4S has 4 MB of flash; the default image header
# says 2 MB, which wastes half the chip. Bump it so both OTA slots fit.
CONFIG_ESPTOOLPY_FLASHSIZE_4MB=y
CONFIG_ESPTOOLPY_FLASHSIZE="4MB"
```
